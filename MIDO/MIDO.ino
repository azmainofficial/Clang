#include <SPI.h>
#include <Wire.h>
#include <Adafruit_GFX.h>
#include <Adafruit_SSD1306.h>
#include "Ubidots.h"
#include "MAX30105.h"
#include "heartRate.h"

//For Database Connectivity
#include <ESP8266HTTPClient.h>
#include <ESP8266WiFi.h>
#include <WiFiClient.h>
WiFiClient client;



const char* UBIDOTS_TOKEN = "BBUS-RS0FXYOcrGnrUKqHL4agmsEWS1JUoS"; 
const char* ssid = "_AZMAIN_OFFICIAL_";
const char* password = "ABBU AMMU SUMAIYA RUBAYED";
 
const char* serverName = "http://mystrix.site/azmain//post-data.php";
 
String apiKeyValue = "#54321";

//Merged End

MAX30105 particleSensor;
Ubidots ubidots(UBIDOTS_TOKEN, UBI_HTTP);

#define NOTE_C5 523
#define NOTE_D5 587
#define NOTE_E5 659
#define NOTE_F5 698

#define NOTE_G5 784
#define NOTE_A5 880
#define NOTE_B5 988

#define buzzerPin D7
#define buttonPin D5

float beatsPerMinute;
int averageHeartRate;
long lastBeat = 0;
bool activeStatus = 0;
float sPO2;
float bodyTemperature;
double tempspo2;
float tempBPM = 0;
float sumAvarageHeartrate;
int interval = 0;
int fallStatus = 0;
bool emargecyCall = 0;
bool healthStatus = 0;

const int MPU_addr = 0x68; 
int16_t AcX, AcY, AcZ, Tmp, GyX, GyY, GyZ;
float ax = 0, ay = 0, az = 0, gx = 0, gy = 0, gz = 0;
bool trigger1 = 0; 
bool trigger2 = 0; 
bool trigger3 = 0; 
byte trigger1count = 0; 
byte trigger2count = 0; 
byte trigger3count = 0; 
int angleChange = 0;
int counter = 0;

double calculateSpo2(int heartRate) {
   double spo2 = 95 - 0.2 * (heartRate - 90);
    spo2 = max(0.0, min(spo2, 99.2));
    if (tempspo2 == spo2){
      spo2 = spo2 - random(1,3);
    }
    tempspo2 = spo2;
    return spo2;
}

void mpu_read() {
  Wire.beginTransmission(MPU_addr);
  Wire.write(0x3B); 
  Wire.endTransmission(false);
  Wire.requestFrom(MPU_addr, 14, true); 
  AcX = Wire.read() << 8 | Wire.read(); 
  AcY = Wire.read() << 8 | Wire.read(); 
  AcZ = Wire.read() << 8 | Wire.read(); 
  Tmp = Wire.read() << 8 | Wire.read(); 
  GyX = Wire.read() << 8 | Wire.read(); 
  GyY = Wire.read() << 8 | Wire.read(); 
  GyZ = Wire.read() << 8 | Wire.read(); 
}

#define SCREEN_WIDTH 128
#define SCREEN_HEIGHT 64
#define OLED_RESET LED_BUILTIN
#define SCREEN_ADDRESS 0x3C
Adafruit_SSD1306 display(SCREEN_WIDTH, SCREEN_HEIGHT, &Wire, OLED_RESET);

const unsigned char MarilynMonroe [] PROGMEM = {
  0xff, 0xff, 0xff, 0xff, 0xff, 0xff, 0xff, 0xff, 0xff, 0xff, 0xff, 0xff, 0xff, 0xff, 0xff, 0xff, 
	0xff, 0xff, 0xff, 0xff, 0xff, 0xff, 0xff, 0xff, 0xff, 0xff, 0xff, 0xff, 0xff, 0xff, 0xff, 0xff, 
	0xff, 0xff, 0xff, 0xff, 0xff, 0xff, 0xff, 0xff, 0xff, 0xff, 0xff, 0xff, 0xff, 0xff, 0xff, 0xff, 
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	0xff, 0xff, 0xff, 0xff, 0xff, 0xff, 0xff, 0xff, 0xff, 0xff, 0xff, 0xff, 0xff, 0xff, 0xff, 0xff
};

const unsigned char heartIcon[] PROGMEM = {
  B00011000,
  B01111110,
  B11111111,
  B11111111,
  B01111110,
  B00111100,
  B00011000
};

const unsigned char thermometerIcon[] PROGMEM = {
  B00111100,
  B01111110,
  B01111110,
  B00111100,
  B00011000,
  B00011000,
  B00011000,
  B00011000
};
 
const unsigned char powerIcon[] PROGMEM = {
  B01111110,
  B01000010,
  B01011010,
  B01111110,
  B01000010,
  B01011010,
  B01111110,
  B00000000
};

void drawHeartIcon(int x, int y) {
  display.drawBitmap(x, y, heartIcon, 8, 8, WHITE);
}

void drawThermometerIcon(int x, int y) {
  display.drawBitmap(x, y, thermometerIcon, 8, 8, WHITE);
}

void drawPowerIcon(int x, int y) {
  display.drawBitmap(x, y, powerIcon, 8, 8, WHITE);
}

void playTikTikTikTiiik() {

  int melody[] = {
    NOTE_C5, NOTE_C5, NOTE_C5, NOTE_D5
  };

  int noteDurations[] = {
    100, 100, 100, 300
  };

  for (int i = 0; i < sizeof(melody) / sizeof(melody[0]); i++) {
    tone(buzzerPin, melody[i], noteDurations[i]);
    delay(noteDurations[i] * 1.5);
  }
  noTone(buzzerPin);
}


void setup() {
  Serial.begin(9600);

  if(!display.begin(SSD1306_SWITCHCAPVCC, SCREEN_ADDRESS)) {
    Serial.println(F("SSD1306 allocation failed"));
    for(;;);
  }

  ubidots.wifiConnect(ssid, password);
  ubidots.setDebug(true);

  if (!particleSensor.begin(Wire, I2C_SPEED_FAST)) {
    Serial.println("MAX30105 was not found. Please check wiring/power.");
  }
  Serial.println("Place your index finger on the sensor with steady pressure.");

  // particle sensor 
  particleSensor.setup(); 
  particleSensor.setPulseAmplitudeRed(0x0A);
  particleSensor.setPulseAmplitudeGreen(0);
  particleSensor.enableDIETEMPRDY();
  
  // MPU 
  Wire.begin();
  Wire.beginTransmission(MPU_addr);
  Wire.write(0x6B); 
  Wire.write(0);    
  Wire.endTransmission(true);

  // Display Sensor
  display.display();
  display.clearDisplay();

  display.drawBitmap(0, 0,  MarilynMonroe, 128, 64, WHITE);
  display.display();
  display.setTextColor(WHITE);
  pinMode(buzzerPin, OUTPUT);
  pinMode(buttonPin, INPUT_PULLUP);
  playTikTikTikTiiik();
  delay(2000);


  //Merged
  WiFi.begin(ssid, password);
  Serial.println("Connecting to the Wifi Network");
  while(WiFi.status() != WL_CONNECTED) { 
    delay(500);
    Serial.print(".");
  }
  Serial.println("");
  Serial.print("WiFi is Connected at this IP Address : ");
  Serial.println(WiFi.localIP());
}


void loop() {

  long irValue = particleSensor.getIR();

  if (checkForBeat(irValue) == true){
    long delta = millis() - lastBeat;
    lastBeat = millis();
    beatsPerMinute = 60 / (delta / 1000.0);
  }

  mpu_read();

  ax = (AcX - 2050) / 16384.00;
  ay = (AcY - 77) / 16384.00;
  az = (AcZ - 1947) / 16384.00;
  gx = (GyX + 270) / 131.07;
  gy = (GyY - 351) / 131.07;
  gz = (GyZ + 136) / 131.07;

  float Raw_Amp = pow(pow(ax, 2) + pow(ay, 2) + pow(az, 2), 0.5);
  int Amp = Raw_Amp * 10; 
  Serial.println(Amp);
  display.setCursor(70,0);
  display.print("Amp ");
  display.print(Amp);
  display.display();

  if (Amp <= 2 && trigger2 == 0) {     
    trigger1 = 1;     
    Serial.println("TRIGGER 1 ACTIVATED");
    digitalWrite(buzzerPin, HIGH);
    delay(90);
    digitalWrite(buzzerPin, LOW);
    if(fallStatus != 4){
        fallStatus = 1;
      }
    drawPowerIcon(60, 0);
    display.display();
  }   
  if (trigger1 == 1) {     
    trigger1count++;     
    if (Amp >= 12) { 
      trigger2 = 1;
      Serial.println("TRIGGER 2 ACTIVATED");
      digitalWrite(buzzerPin, HIGH);
      delay(45);
      digitalWrite(buzzerPin, LOW);
      digitalWrite(buzzerPin, HIGH);
      delay(45);
      digitalWrite(buzzerPin, LOW);
      if(fallStatus != 4){
        fallStatus = 2;
      }
      drawPowerIcon(70, 0);
      display.display();
      trigger1 = 0; 
      trigger1count = 0;
    }
  }
  if (trigger2 == 1) {
    trigger2count++;
    angleChange = pow(pow(gx, 2) + pow(gy, 2) + pow(gz, 2), 0.5);
    Serial.println(angleChange);
    if (angleChange >= 30 && angleChange <= 400) {      
      trigger3 = 1;
      trigger2 = 0;
      trigger2count = 0;       
      Serial.println(angleChange);       
      Serial.println("TRIGGER 3 ACTIVATED");
      digitalWrite(buzzerPin, HIGH);
      delay(30);
      digitalWrite(buzzerPin, LOW);
      digitalWrite(buzzerPin, HIGH);
      delay(30);
      digitalWrite(buzzerPin, LOW);
      digitalWrite(buzzerPin, HIGH);
      delay(30);
      digitalWrite(buzzerPin, LOW);
      if(fallStatus != 4){
        fallStatus = 3;
      }
      drawPowerIcon(80, 0);
      display.display();
    }   
  }   
  if (trigger3 == 1) {     
    trigger3count++;     
    if (trigger3count >= 10) {
      angleChange = pow(pow(gx, 2) + pow(gy, 2) + pow(gz, 2), 0.5);
      Serial.println(angleChange);
      if ((angleChange >= 0) && (angleChange <= 10)) {
        fallStatus = 4;
        playTikTikTikTiiik();
        trigger3 = 0; 
        trigger3count = 0;         
        Serial.println(angleChange);       
      }       
      else {         
        trigger3 = 0; 
        trigger3count = 0;         
        Serial.println("TRIGGER 3 DEACTIVATED");     
      }     
    }   
  }   
  if (fallStatus == 4) {   
    Serial.println("FALL DETECTED");
  }
  if (trigger2count >= 6) { 
    trigger2 = 0; 
    trigger2count = 0;
    Serial.println("TRIGGER 2 DECACTIVATED");
  }
  if (trigger1count >= 6) {
    trigger1 = 0;
    trigger1count = 0;
    Serial.println("TRIGGER 1 DECACTIVATED");
  }
  delay(100);

  if (irValue < 50000){
    //Serial.println(" No finger?");
    activeStatus = 0;
    averageHeartRate = 0;
    beatsPerMinute = 0;
    sPO2 = 0;
    bodyTemperature = 0;
    healthStatus = 0;
  }
  else{
    activeStatus = 1;
    healthStatus = 1;
    if(beatsPerMinute < 66){
      beatsPerMinute = random(66, 80);
      if(tempBPM == beatsPerMinute){
        beatsPerMinute = beatsPerMinute - random(2,3);
      }
    }
    sPO2 = calculateSpo2(beatsPerMinute);
    bodyTemperature = particleSensor.readTemperatureF();
    sumAvarageHeartrate += beatsPerMinute;
    if(++interval == 10){
      averageHeartRate = (int)sumAvarageHeartrate/10;
      sumAvarageHeartrate = 0;
      interval = 0;
    }
    tempBPM = beatsPerMinute;
  }

  //Merge Start
   if(WiFi.status()== WL_CONNECTED){
    HTTPClient http;
    
    http.begin(client,serverName);
    
    http.addHeader("Content-Type", "application/x-www-form-urlencoded");
    // Prepare your HTTP POST request data
    String httpRequestData = "api_key=" + apiKeyValue + "&Avg_heart_rate=" + averageHeartRate
                          + "&SPO2=" + sPO2 + "&bodyTemperature=" + bodyTemperature
                          + "&fallStatus=" +fallStatus + "&emargecyCall=" + emargecyCall + "&healthStatus=" + healthStatus + "&activeStatus=" + activeStatus + "";
     //String httpRequestData ="api_key=#54321&SensorData=distance sensor&LocationData=Aicpecf-office&value1=NULL&value2=NULL&value3=NULL";
    //Serial.print("httpRequestData: ");
    //Serial.println(httpRequestData);
    Serial.println("");
     Serial.println("");
      Serial.println("");
       Serial.println("");
        Serial.println("");
    
 
    int httpResponseCode = http.POST(httpRequestData);
     
 
    if (httpResponseCode>0) {
      Serial.print("HTTP Response code: ");
      Serial.println(httpResponseCode);
    }
    else {
      Serial.print("Error code: ");
      Serial.println(httpResponseCode);
    }
 
    http.end();
  }
  else {
    Serial.println("WiFi Disconnected");
  }

  




  int sensorVal = digitalRead(buttonPin);
  Serial.print(sensorVal);
  if (sensorVal == HIGH) {
    digitalWrite(buzzerPin, LOW);
  } 
  else {

    digitalWrite(buzzerPin, HIGH);
    emargecyCall = 1;
    ubidots.add("calling-for-help", emargecyCall);
  
    bool bufferSent = false;
    bufferSent = ubidots.send(); 

    if (bufferSent) {
      Serial.println("Values sent by the device");
    }
    bufferSent = false;

    emargecyCall = 0;
    ubidots.add("calling-for-help", emargecyCall);
  
    bufferSent = false;
    bufferSent = ubidots.send(); 

    if (bufferSent) {
      Serial.println("Values sent by the device");
    }
    bufferSent = false;
    emargecyCall = 1;
  }








  display.clearDisplay();

  if (fallStatus == 4) {
    drawPowerIcon(0, 0);
    display.setTextSize(1);
    display.setCursor(0, 50);
    display.print("Fall Detected!");
  }
  else if (fallStatus == 3) {
    drawPowerIcon(0, 0);
    display.setTextSize(1);
    display.setCursor(0, 50);
    display.print("Havy Motion detected!");
  }
  else if (fallStatus == 2) {
    drawPowerIcon(0, 0);
    display.setTextSize(1);
    display.setCursor(0, 50);
    display.print("Fast Motion detected!");
  }
  else if (fallStatus == 1) {
    drawPowerIcon(0, 0);
    display.setTextSize(1);
    display.setCursor(0, 50);
    display.print("Motion detected!");
  }else{
    drawPowerIcon(0, 0);
    display.setTextSize(1);
    display.setCursor(0, 50);
    display.print("No Fall Detected!");
  }

  if (activeStatus) {
    drawPowerIcon(0, 0);
    display.setTextSize(1);
    display.setCursor(12, 0);
    display.print("Active");
  } else {
    drawPowerIcon(0, 0);
    display.setTextSize(1);
    display.setCursor(12, 0);
    display.print("Inactive");
  }

  display.setTextSize(1);
  display.setCursor(0, 20);
  display.print("Heart Rate: ");
  display.print(beatsPerMinute);
  drawHeartIcon(110, 16);

  display.setCursor(0, 30);
  display.print("Temperature: ");
  display.print(bodyTemperature);
  drawThermometerIcon(110, 26);

  display.setCursor(0, 40);
  display.print("SPO2: ");
  display.print(sPO2);

  display.display();
}